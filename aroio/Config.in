## aroio/Config.in
```kconfig
menu "Perl CPAN Packages"
	source "$BR2_EXTERNAL_aroio_PATH/package/perl-exporter-tiny/Config.in"
	source "$BR2_EXTERNAL_aroio_PATH/package/perl-list-moreutils-xs/Config.in"
	source "$BR2_EXTERNAL_aroio_PATH/package/perl-list-moreutils/Config.in"
    source "$BR2_EXTERNAL_aroio_PATH/package/perl-algorithm-c3/Config.in"
    source "$BR2_EXTERNAL_aroio_PATH/package/perl-anyevent/Config.in"
    source "$BR2_EXTERNAL_aroio_PATH/package/perl-appconfig/Config.in"
    source "$BR2_EXTERNAL_aroio_PATH/package/perl-archive-zip/Config.in"
    source "$BR2_EXTERNAL_aroio_PATH/package/perl-audio-cuefile-parser/Config.in"
    source "$BR2_EXTERNAL_aroio_PATH/package/perl-audio-cuefile-parser/Config.in"
    source "$BR2_EXTERNAL_aroio_PATH/package/perl-audio-scan/Config.in"
    source "$BR2_EXTERNAL_aroio_PATH/package/perl-b-hooks-endofscope/Config.in"
    source "$BR2_EXTERNAL_aroio_PATH/package/perl-carp-assert/Config.in"
    source "$BR2_EXTERNAL_aroio_PATH/package/perl-carp-clan/Config.in"
    source "$BR2_EXTERNAL_aroio_PATH/package/perl-cgi/Config.in"
    source "$BR2_EXTERNAL_aroio_PATH/package/perl-class-accessor-chained/Config.in"
    source "$BR2_EXTERNAL_aroio_PATH/package/perl-class-accessor-grouped/Config.in"
    source "$BR2_EXTERNAL_aroio_PATH/package/perl-class-accessor/Config.in"
    source "$BR2_EXTERNAL_aroio_PATH/package/perl-class-c3-componentised/Config.in"
    source "$BR2_EXTERNAL_aroio_PATH/package/perl-class-c3-xs/Config.in"
    source "$BR2_EXTERNAL_aroio_PATH/package/perl-class-c3/Config.in"
    source "$BR2_EXTERNAL_aroio_PATH/package/perl-class-data-inheritable/Config.in"
    source "$BR2_EXTERNAL_aroio_PATH/package/perl-class-data-inheritable/Config.in"
    source "$BR2_EXTERNAL_aroio_PATH/package/perl-class-data-inheritable/Config.in"
    source "$BR2_EXTERNAL_aroio_PATH/package/perl-class-inspector/Config.in"
    source "$BR2_EXTERNAL_aroio_PATH/package/perl-class-isa/Config.in"
    source "$BR2_EXTERNAL_aroio_PATH/package/perl-class-method-modifiers/Config.in"
    source "$BR2_EXTERNAL_aroio_PATH/package/perl-class-virtual/Config.in"
    source "$BR2_EXTERNAL_aroio_PATH/package/perl-class-xsaccessor/Config.in"
    source "$BR2_EXTERNAL_aroio_PATH/package/perl-clone-choose/Config.in"
    source "$BR2_EXTERNAL_aroio_PATH/package/perl-common-sense/Config.in"
    source "$BR2_EXTERNAL_aroio_PATH/package/perl-compress-raw-zlib/Config.in"
    source "$BR2_EXTERNAL_aroio_PATH/package/perl-config-any/Config.in"
    source "$BR2_EXTERNAL_aroio_PATH/package/perl-context-preserve/Config.in"
    source "$BR2_EXTERNAL_aroio_PATH/package/perl-context-preserve/Config.in"
    source "$BR2_EXTERNAL_aroio_PATH/package/perl-data-dump/Config.in"
    source "$BR2_EXTERNAL_aroio_PATH/package/perl-data-dumper-concise/Config.in"
    source "$BR2_EXTERNAL_aroio_PATH/package/perl-data-page/Config.in"
    source "$BR2_EXTERNAL_aroio_PATH/package/perl-data-uriencode/Config.in"
    source "$BR2_EXTERNAL_aroio_PATH/package/perl-dbd-mysql/Config.in"
    source "$BR2_EXTERNAL_aroio_PATH/package/perl-dbd-sqlite/Config.in"
    source "$BR2_EXTERNAL_aroio_PATH/package/perl-dbi/Config.in"
    source "$BR2_EXTERNAL_aroio_PATH/package/perl-dbix-class/Config.in"
    source "$BR2_EXTERNAL_aroio_PATH/package/perl-devel-globaldestruction/Config.in"
    source "$BR2_EXTERNAL_aroio_PATH/package/perl-enum/Config.in"
    source "$BR2_EXTERNAL_aroio_PATH/package/perl-ev/Config.in"
    source "$BR2_EXTERNAL_aroio_PATH/package/perl-exporter-lite/Config.in"
    source "$BR2_EXTERNAL_aroio_PATH/package/perl-extutils-cbuilder/Config.in"
    source "$BR2_EXTERNAL_aroio_PATH/package/perl-file-bom/Config.in"
    source "$BR2_EXTERNAL_aroio_PATH/package/perl-file-next/Config.in"
    source "$BR2_EXTERNAL_aroio_PATH/package/perl-file-readbackwards/Config.in"
    source "$BR2_EXTERNAL_aroio_PATH/package/perl-file-slurp-tiny/Config.in"
    source "$BR2_EXTERNAL_aroio_PATH/package/perl-file-slurp/Config.in"
    source "$BR2_EXTERNAL_aroio_PATH/package/perl-file-which/Config.in"
    source "$BR2_EXTERNAL_aroio_PATH/package/perl-font-freetype/Config.in"
    source "$BR2_EXTERNAL_aroio_PATH/package/perl-hash-merge/Config.in"
    source "$BR2_EXTERNAL_aroio_PATH/package/perl-image-scale/Config.in"
    source "$BR2_EXTERNAL_aroio_PATH/package/perl-io-aio/Config.in"
    source "$BR2_EXTERNAL_aroio_PATH/package/perl-io-interface/Config.in"
    source "$BR2_EXTERNAL_aroio_PATH/package/perl-io-string/Config.in"
    source "$BR2_EXTERNAL_aroio_PATH/package/perl-json-xs-versiononeandtwo/Config.in"
    source "$BR2_EXTERNAL_aroio_PATH/package/perl-json-xs/Config.in"
    source "$BR2_EXTERNAL_aroio_PATH/package/perl-linux-inotify2/Config.in"
    source "$BR2_EXTERNAL_aroio_PATH/package/perl-log-log4perl/Config.in"
    source "$BR2_EXTERNAL_aroio_PATH/package/perl-module-find/Config.in"
    source "$BR2_EXTERNAL_aroio_PATH/package/perl-module-implementation/Config.in"
    source "$BR2_EXTERNAL_aroio_PATH/package/perl-module-pluggable/Config.in"
    source "$BR2_EXTERNAL_aroio_PATH/package/perl-module-runtime/Config.in"
    source "$BR2_EXTERNAL_aroio_PATH/package/perl-moo/Config.in"
    source "$BR2_EXTERNAL_aroio_PATH/package/perl-mp3-cut-gapless/Config.in"
    source "$BR2_EXTERNAL_aroio_PATH/package/perl-mro-compat/Config.in"
    source "$BR2_EXTERNAL_aroio_PATH/package/perl-namespace-clean/Config.in"
    source "$BR2_EXTERNAL_aroio_PATH/package/perl-network-ipv4addr/Config.in"
    source "$BR2_EXTERNAL_aroio_PATH/package/perl-package-stash/Config.in"
    source "$BR2_EXTERNAL_aroio_PATH/package/perl-path-class/Config.in"
    source "$BR2_EXTERNAL_aroio_PATH/package/perl-readonly/Config.in"
    source "$BR2_EXTERNAL_aroio_PATH/package/perl-role-tiny/Config.in"
    source "$BR2_EXTERNAL_aroio_PATH/package/perl-scope-guard/Config.in"
    source "$BR2_EXTERNAL_aroio_PATH/package/perl-soap-lite/Config.in"
    source "$BR2_EXTERNAL_aroio_PATH/package/perl-sql-abstract-limit/Config.in"
    source "$BR2_EXTERNAL_aroio_PATH/package/perl-sql-abstract/Config.in"
    source "$BR2_EXTERNAL_aroio_PATH/package/perl-sub-exporter-progressive/Config.in"
    source "$BR2_EXTERNAL_aroio_PATH/package/perl-sub-name/Config.in"
    source "$BR2_EXTERNAL_aroio_PATH/package/perl-sub-quote/Config.in"
    source "$BR2_EXTERNAL_aroio_PATH/package/perl-sub-uplevel/Config.in"
    source "$BR2_EXTERNAL_aroio_PATH/package/perl-template-toolkit/Config.in"
    source "$BR2_EXTERNAL_aroio_PATH/package/perl-text-unidecode/Config.in"
    source "$BR2_EXTERNAL_aroio_PATH/package/perl-tie-cache-lru-expires/Config.in"
    source "$BR2_EXTERNAL_aroio_PATH/package/perl-tie-cache-lru/Config.in"
    source "$BR2_EXTERNAL_aroio_PATH/package/perl-tie-regexphash/Config.in"
    source "$BR2_EXTERNAL_aroio_PATH/package/perl-tree-dag-node/Config.in"
    source "$BR2_EXTERNAL_aroio_PATH/package/perl-types-serialiser/Config.in"
    source "$BR2_EXTERNAL_aroio_PATH/package/perl-uri-find/Config.in"
    source "$BR2_EXTERNAL_aroio_PATH/package/perl-uuid-tiny/Config.in"
    source "$BR2_EXTERNAL_aroio_PATH/package/perl-xml-sax-expat/Config.in"
    source "$BR2_EXTERNAL_aroio_PATH/package/perl-xml-simple/Config.in"
    source "$BR2_EXTERNAL_aroio_PATH/package/perl-yaml-libyaml/Config.in"
endmenu


source "$BR2_EXTERNAL_aroio_PATH/package/logsweep/Config.in"
source "$BR2_EXTERNAL_aroio_PATH/package/ladspa/Config.in"
source "$BR2_EXTERNAL_aroio_PATH/package/bluez-alsa/Config.in"
source "$BR2_EXTERNAL_aroio_PATH/package/alsa-plugins/Config.in"
source "$BR2_EXTERNAL_aroio_PATH/package/ng-jackspa/Config.in"
source "$BR2_EXTERNAL_aroio_PATH/package/slimserver/Config.in"
source "$BR2_EXTERNAL_aroio_PATH/package/squeezelite-jack/Config.in"
source "$BR2_EXTERNAL_aroio_PATH/package/fftw3f/Config.in"
source "$BR2_EXTERNAL_aroio_PATH/package/brutefir/Config.in"
source "$BR2_EXTERNAL_aroio_PATH/package/jack-connect-persistent/Config.in"
source "$BR2_EXTERNAL_aroio_PATH/package/jack_minimix/Config.in"
source "$BR2_EXTERNAL_aroio_PATH/package/rtl8812au/Config.in" 
```

## aroio/configs/aroio_defconfig
```kconfig
BR2_arm=y
BR2_cortex_a53=y
BR2_ARM_FPU_NEON_VFPV4=y
BR2_CCACHE=y
BR2_TOOLCHAIN_BUILDROOT_GLIBC=y
BR2_KERNEL_HEADERS_4_9=y
BR2_TOOLCHAIN_BUILDROOT_CXX=y
BR2_TARGET_GENERIC_HOSTNAME="AroioOS"
BR2_TARGET_GENERIC_ISSUE="Welcome to Aroio"
BR2_INIT_SYSTEMD=y
BR2_TARGET_GENERIC_ROOT_PASSWD="aroio"
# BR2_TARGET_GENERIC_GETTY is not set
BR2_SYSTEM_DHCP="eth0"
BR2_ROOTFS_USERS_TABLES="../aroio/user_sftparoio"
BR2_ROOTFS_OVERLAY="../aroio/overlay"
BR2_ROOTFS_POST_BUILD_SCRIPT="board/raspberrypi3/post-build.sh"
BR2_ROOTFS_POST_IMAGE_SCRIPT="../aroio/boards/RaspberryPi/post-image.sh"
BR2_ROOTFS_POST_SCRIPT_ARGS="--add-pi3-miniuart-bt-overlay"
BR2_LINUX_KERNEL=y
BR2_LINUX_KERNEL_CUSTOM_TARBALL=y
BR2_LINUX_KERNEL_CUSTOM_TARBALL_LOCATION="https://github.com/raspberrypi/linux/archive/6dabe04c82943c34fb5bcadc9cc2ee7b6b4a145b.tar.gz"
BR2_LINUX_KERNEL_PATCH="../aroio/boards/RaspberryPi/kernel_patches"
BR2_LINUX_KERNEL_USE_CUSTOM_CONFIG=y
BR2_LINUX_KERNEL_CUSTOM_CONFIG_FILE="../aroio/boards/RaspberryPi/linux-config"
BR2_LINUX_KERNEL_LZO=y
BR2_LINUX_KERNEL_DTS_SUPPORT=y
BR2_LINUX_KERNEL_INTREE_DTS_NAME="bcm2710-rpi-3-b bcm2710-rpi-cm3"
BR2_PACKAGE_BUSYBOX_CONFIG="../aroio/busybox/busybox.config"
BR2_PACKAGE_ALSA_UTILS=y
BR2_PACKAGE_ALSA_UTILS_AMIXER=y
BR2_PACKAGE_ALSA_UTILS_APLAY=y
BR2_PACKAGE_ALSA_UTILS_SPEAKER_TEST=y
BR2_PACKAGE_AUMIX=y
# BR2_PACKAGE_FFMPEG_FFMPEG is not set
BR2_PACKAGE_FFMPEG_ENCODERS="none"
BR2_PACKAGE_FFMPEG_DECODERS="aac,ogg,opus,alc,wma,wmap,wmal"
BR2_PACKAGE_FFMPEG_MUXERS="none"
BR2_PACKAGE_FFMPEG_DEMUXERS="none"
BR2_PACKAGE_FFMPEG_PARSERS="none"
BR2_PACKAGE_FFMPEG_PROTOCOLS="none"
BR2_PACKAGE_FFMPEG_FILTERS="none"
# BR2_PACKAGE_FFMPEG_INDEVS is not set
# BR2_PACKAGE_FFMPEG_OUTDEVS is not set
BR2_PACKAGE_GMRENDER_RESURRECT=y
BR2_PACKAGE_GST1_PLUGINS_BASE_PLUGIN_ALSA=y
BR2_PACKAGE_GST1_PLUGINS_BASE_PLUGIN_OGG=y
BR2_PACKAGE_GST1_PLUGINS_BASE_PLUGIN_VORBIS=y
BR2_PACKAGE_GST1_PLUGINS_GOOD=y
BR2_PACKAGE_GST1_PLUGINS_GOOD_PLUGIN_AUDIOPARSERS=y
# BR2_PACKAGE_GST1_PLUGINS_GOOD_PLUGIN_AVI is not set
BR2_PACKAGE_GST1_PLUGINS_GOOD_PLUGIN_ID3DEMUX=y
BR2_PACKAGE_GST1_PLUGINS_GOOD_PLUGIN_REPLAYGAIN=y
BR2_PACKAGE_GST1_PLUGINS_GOOD_PLUGIN_RTSP=y
BR2_PACKAGE_GST1_PLUGINS_GOOD_PLUGIN_UDP=y
BR2_PACKAGE_GST1_PLUGINS_GOOD_PLUGIN_FLAC=y
BR2_PACKAGE_GST1_PLUGINS_GOOD_PLUGIN_SOUPHTTPSRC=y
BR2_PACKAGE_GST1_PLUGINS_BAD=y
BR2_PACKAGE_GST1_PLUGINS_BAD_PLUGIN_ID3TAG=y
BR2_PACKAGE_GST1_PLUGINS_UGLY=y
BR2_PACKAGE_GST1_PLUGINS_UGLY_PLUGIN_MPG123=y
BR2_PACKAGE_SOX=y
BR2_PACKAGE_SQUEEZELITE=y
BR2_PACKAGE_SQUEEZELITE_DSD=y
BR2_PACKAGE_SQUEEZELITE_RESAMPLE=y
BR2_PACKAGE_P7ZIP=y
BR2_PACKAGE_XZ=y
BR2_PACKAGE_STRACE=y
BR2_PACKAGE_LIBTOOL=y
BR2_PACKAGE_LINUX_FIRMWARE_RTL_81XX=y
BR2_PACKAGE_LINUX_FIRMWARE_RTL_87XX=y
BR2_PACKAGE_LINUX_FIRMWARE_RTL_88XX=y
BR2_PACKAGE_RPI_FIRMWARE=y
BR2_PACKAGE_RPI_FIRMWARE_INSTALL_VCDBG=y
BR2_PACKAGE_RPI_WIFI_FIRMWARE=y
BR2_PACKAGE_DBUS_PYTHON=y
BR2_PACKAGE_I2C_TOOLS=y
BR2_PACKAGE_LIRC_TOOLS=y
BR2_PACKAGE_RTL8821AU=y
BR2_PACKAGE_PHP=y
BR2_PACKAGE_PHP_EXT_READLINE=y
BR2_PACKAGE_PYTHON3=y
BR2_PACKAGE_PYTHON_ARGH=y
BR2_PACKAGE_PYTHON_GOBJECT=y
BR2_PACKAGE_PYTHON_LXML=y
BR2_PACKAGE_PYTHON_PATHTOOLS=y
BR2_PACKAGE_PYTHON_PYYAML=y
BR2_PACKAGE_PYTHON_RPI_GPIO=y
BR2_PACKAGE_LIBLO=y
BR2_PACKAGE_SPEEX=y
BR2_PACKAGE_LIBGCRYPT=y
BR2_PACKAGE_BC=y
BR2_PACKAGE_BLUEZ5_UTILS_CLIENT=y
BR2_PACKAGE_BLUEZ5_UTILS_DEPRECATED=y
BR2_PACKAGE_DROPBEAR=y
BR2_PACKAGE_GESFTPSERVER=y
BR2_PACKAGE_HOSTAPD=y
BR2_PACKAGE_HOSTAPD_WPS=y
BR2_PACKAGE_IFPLUGD=y
BR2_PACKAGE_IPROUTE2=y
BR2_PACKAGE_IPTABLES=y
BR2_PACKAGE_NETCAT_OPENBSD=y
BR2_PACKAGE_RSYNC=y
BR2_PACKAGE_SHAIRPORT_SYNC=y
BR2_PACKAGE_SHAIRPORT_SYNC_LIBSOXR=y
BR2_PACKAGE_UHTTPD=y
BR2_PACKAGE_WIRELESS_REGDB=y
BR2_PACKAGE_WIRELESS_TOOLS=y
BR2_PACKAGE_WIRELESS_TOOLS_LIB=y
BR2_PACKAGE_WPA_SUPPLICANT=y
BR2_PACKAGE_WPA_SUPPLICANT_AP_SUPPORT=y
BR2_PACKAGE_WPA_SUPPLICANT_WIFI_DISPLAY=y
BR2_PACKAGE_WPA_SUPPLICANT_AUTOSCAN=y
BR2_PACKAGE_WPA_SUPPLICANT_CLI=y
BR2_PACKAGE_WPA_SUPPLICANT_WPA_CLIENT_SO=y
BR2_PACKAGE_WPA_SUPPLICANT_PASSPHRASE=y
BR2_PACKAGE_WPA_SUPPLICANT_DBUS_NEW=y
BR2_PACKAGE_INOTIFY_TOOLS=y
BR2_PACKAGE_DC3DD=y
BR2_PACKAGE_HTOP=y
BR2_PACKAGE_PROCPS_NG=y
# BR2_PACKAGE_SYSTEMD_HOSTNAMED is not set
BR2_PACKAGE_SYSTEMD_RFKILL=y
# BR2_PACKAGE_SYSTEMD_TIMESYNCD is not set
BR2_PACKAGE_TAR=y
BR2_PACKAGE_UTIL_LINUX_RFKILL=y
BR2_PACKAGE_UTIL_LINUX_SCHEDUTILS=y
BR2_PACKAGE_NANO=y
# BR2_PACKAGE_NANO_TINY is not set
BR2_TARGET_ROOTFS_EXT2=y
BR2_TARGET_ROOTFS_EXT2_4=y
BR2_TARGET_ROOTFS_EXT2_SIZE="160M"
BR2_TARGET_ROOTFS_INITRAMFS=y
# BR2_TARGET_ROOTFS_TAR is not set
BR2_PACKAGE_HOST_DOSFSTOOLS=y
BR2_PACKAGE_HOST_GENIMAGE=y
BR2_PACKAGE_HOST_MTOOLS=y
BR2_PACKAGE_LOGSWEEP=y
BR2_PACKAGE_FILTER=y
BR2_PACKAGE_LADSPA=y
BR2_PACKAGE_BLUEZ_ALSA=y
BR2_PACKAGE_ALSA_PLUGINS=y
BR2_PACKAGE_BRUTEFIR=y
BR2_PACKAGE_JACK_CONNECT_PERSISTENT=y
BR2_PACKAGE_JACK_MINIMIX=y
```

## aroio/package/alac-decoder/Config.in
```kconfig
config BR2_PACKAGE_ALAC_DECODER
	bool "alac-decoder"
	help
	  alac decoder

	  https://github.com/TimothyGu/alac
```

## aroio/package/alsacap/Config.in
```kconfig
config BR2_PACKAGE_ALSACAP
	bool "alsacap"
	#depends on BR2_PACKAGE_ALSA_LIB
	depends on BR2_TOOLCHAIN_HAS_THREADS # alsa-lib
	select BR2_PACKAGE_ALSA_LIB
	help
	  Alsa capability tool

	  https://github.com/bubbapizza/alsacap
```

## aroio/package/aroio-ui/Config.in
```kconfig
config BR2_PACKAGE_AROIO_UI
    bool "aroio-ui"
    select BR2_PACKAGE_PYTHON3
    select BR2_PACKAGE_PYTHON_FLASK
    help
        Aroio UI - Python based API and NuxtJS based Interface
```

## aroio/package/aroio-webinterface/Config.in
```kconfig
config BR2_PACKAGE_AROIO_WEBINTERFACE
    bool "aroio-webinterface"
    help
        Aroio Webinterace - Python based API and Angular based Interface
```

## aroio/package/bluez-alsa/Config.in
```kconfig
config BR2_PACKAGE_BLUEZ_ALSA
	bool "bluez-alsa"
	depends on BR2_TOOLCHAIN_HAS_THREADS # alsa-lib
	select BR2_PACKAGE_ALSA_LIB
	select BR2_PACKAGE_ALSA_LIB_MIXER
	select BR2_PACKAGE_SBC
	select BR2_PACKAGE_BLUEZ5_UTILS
	select BR2_PACKAGE_FDK_AAC
	help
	  Bluetooth Audio Alsa Backend

	  https://github.com/Arkq/bluez-alsa
```

## aroio/package/brutefir/Config.in
```kconfig
config BR2_PACKAGE_BRUTEFIR
       bool "brutefir"
       select BR2_PACKAGE_FFTW
       select BR2_PACKAGE_FFTW3F
       select BR2_PACKAGE_JACK2
       help
         brutefir convolver

	 http://www.ludd.luth.se/~torger/brutefir.html
```

## aroio/package/fftw3f/Config.in
```kconfig
config BR2_PACKAGE_FFTW3F
	bool "fftw3f"
	help
	  Library for computing Fast Fourier Transforms.

	  This library computes Fast Fourier Transforms (FFT) in one
	  or more dimensions. It is extremely fast. This package
	  contains the shared library version of the fftw libraries in
	  single precision.

	  http://www.fftw.org

if BR2_PACKAGE_FFTW3F

config BR2_PACKAGE_FFTW3F_USE_SSE
	bool

config BR2_PACKAGE_FFTW3F_USE_SSE2
	bool

config BR2_PACKAGE_FFTW3F_USE_NEON
	bool

config BR2_PACKAGE_FFTW3F_FAST
	bool "optimise for speed over accuracy"
	help
	  Optimise for fast math functions, at the expense of accuracy.

	  Say 'y' if you need speed and can live with inaccuracies in
	  the results. Say 'n' (the default) if accuracy is of utmost
	  importance.

	  This basically uses gcc's -Ofast optimisation level, which in
	  turn is basically using gcc's -ffast-math. See the gcc manual
	  for what this means.

endif
```

## aroio/package/filter/Config.in
```kconfig
config BR2_PACKAGE_FILTER
       bool "filter"
       help
         Filter for brutefir
```

## aroio/package/jack-connect-persistent/Config.in
```kconfig
config BR2_PACKAGE_JACK_CONNECT_PERSISTENT
        bool "jack connect persistent"
        depends on BR2_INSTALL_LIBSTDCPP
        select BR2_PACKAGE_JACK2
        help
          A client like jack_connect, only persistent.

          https://github.com/worosom/jack_connect_persistent
```
