## aroio/package/jack_minimix/Config.in
```kconfig
config BR2_PACKAGE_JACK_MINIMIX
	   bool "jack_minimix"
	   depends on BR2_TOOLCHAIN_HAS_THREADS
	   help
	     Jack Mixer using OSC

comment "liblo needs a toolchain w/ threads"
	depends on !BR2_TOOLCHAIN_HAS_THREADS
```

## aroio/package/ladspa/Config.in
```kconfig
config BR2_PACKAGE_LADSPA
       bool "ladspa"
       select BR2_PACKAGE_FFTW
       select BR2_PACKAGE_FFTW3F
       select BR2_PACKAGE_PERL_LIST_MOREUTILS
       help
         Steve Harris LADSPA plugins

	 http://plugin.org.uk/
```

## aroio/package/ldacbt/Config.in
```kconfig
config BR2_PACKAGE_LDACBT
	bool "ldacbt"
	help
	  LDAC for bluetooth
	  https://github.com/EHfive/ldacBT
```

## aroio/package/librespot/Config.in
```kconfig
config BR2_PACKAGE_LIBRESPOT
	bool "librespot"
	depends on BR2_PACKAGE_HOST_RUSTC_TARGET_ARCH_SUPPORTS
	select BR2_PACKAGE_HOST_CARGO
	help
		Open source spotify client

		https://github.com/librespot-org/librespot
```

## aroio/package/logsweep/Config.in
```kconfig
config BR2_PACKAGE_LOGSWEEP
       bool "logsweep"
       help
         Logsweeps for Measurement recording

	 http://www.audiovero.de
```

## aroio/package/ng-jackspa/Config.in
```kconfig
config BR2_PACKAGE_NG_JACKSPA
	bool "ng-jackspa"
	#depends on BR2_TOOLCHAIN_HAS_THREADS # alsa-lib
	#select BR2_PACKAGE_ALSA_LIB
	#select BR2_PACKAGE_ALSA_LIB_MIXER
	#select BR2_PACKAGE_SBC
	#select BR2_PACKAGE_BLUEZ5_UTILS
	#select BR2_PACKAGE_FDK_AAC
	help
	  LADSPA command line hostfor jack

	  https://github.com/7890/ng-jackspa
```

## aroio/package/perl-anyevent/Config.in
```kconfig
config BR2_PACKAGE_PERL_ANYEVENT
	bool "perl-anyevent"
	help
	  simpler/faster/newer/cooler AnyEvent API

	  https://metacpan.org/release/AnyEvent
```

## aroio/package/perl-archive-zip/Config.in
```kconfig
config BR2_PACKAGE_PERL_ARCHIVE_ZIP
	bool "perl-archive-zip"
	help
	  Provide an interface to ZIP archive files.

	  https://metacpan.org/release/Archive-Zip
```

## aroio/package/perl-audio-cuefile-parser/Config.in
```kconfig
config BR2_PACKAGE_PERL_AUDIO_CUEFILE_PARSER
	bool "perl-audio-cuefile-parser"
	help
	  https://metacpan.org/release/Audio-Cuefile-Parser
```

## aroio/package/perl-audio-scan/Config.in
```kconfig
config BR2_PACKAGE_PERL_AUDIO_SCAN
	bool "perl-audio-scan"
	depends on !BR2_STATIC_LIBS
	help
	  Fast C metadata and tag reader for all common audio file formats

	  https://metacpan.org/release/Audio-Scan

comment "perl-audio-scan needs a toolchain w/ dynamic library"
	depends on BR2_STATIC_LIBS
```

## aroio/package/perl-carp-assert/Config.in
```kconfig
config BR2_PACKAGE_PERL_CARP_ASSERT
	bool "perl-carp-assert"
	help
	  executable comments

	  https://metacpan.org/release/Carp-Assert
```

## aroio/package/perl-class-accessor-chained/Config.in
```kconfig
config BR2_PACKAGE_PERL_CLASS_ACCESSOR_CHAINED
	bool "perl-class-accessor-chained"
	select BR2_PACKAGE_PERL_CLASS_ACCESSOR
	help
	  make chained accessors

	  https://metacpan.org/release/Class-Accessor-Chained
```

## aroio/package/perl-class-c3-xs/Config.in
```kconfig
config BR2_PACKAGE_PERL_CLASS_C3_XS
	bool "perl-class-c3-xs"
	depends on !BR2_STATIC_LIBS
	help
	  XS speedups for Class::C3

	  https://github.com/moose/Class-C3-XS

comment "perl-class-c3-xs needs a toolchain w/ dynamic library"
	depends on BR2_STATIC_LIBS
```

## aroio/package/perl-class-data-inheritable/Config.in
```kconfig
config BR2_PACKAGE_PERL_CLASS_DATA_INHERITABLE
	bool "perl-class-data-inheritable"
	help
	  Inheritable, overridable class data

	  https://metacpan.org/release/Class-Data-Inheritable
```
