## aroio/package/perl-list-moreutils-xs/Config.in
```kconfig
config BR2_PACKAGE_PERL_LIST_MOREUTILS_XS
	bool "perl-list-moreutils-xs"
	depends on !BR2_STATIC_LIBS
	help
	  Provide the stuff missing in List::Util in XS

	  https://metacpan.org/release/List-MoreUtils-XS

comment "perl-list-moreutils-xs needs a toolchain w/ dynamic library"
	depends on BR2_STATIC_LIBS
```

## aroio/package/perl-log-log4perl/Config.in
```kconfig
config BR2_PACKAGE_PERL_LOG_LOG4PERL
	bool "perl-log-log4perl"
	help
	  Log4j implementation for Perl

	  https://metacpan.org/release/Log-Log4perl
```

## aroio/package/perl-mp3-cut-gapless/Config.in
```kconfig
config BR2_PACKAGE_PERL_MP3_CUT_GAPLESS
	bool "perl-mp3-cut-gapless"
	depends on !BR2_STATIC_LIBS
	select BR2_PACKAGE_PERL_AUDIO_CUEFILE_PARSER
	help
	  Split an MP3 file without gaps (based on pcutmp3)

	  https://metacpan.org/release/MP3-Cut-Gapless

comment "perl-mp3-cut-gapless needs a toolchain w/ dynamic library"
	depends on BR2_STATIC_LIBS
```

## aroio/package/perl-network-ipv4addr/Config.in
```kconfig
config BR2_PACKAGE_PERL_NETWORK_IPV4ADDR
	bool "perl-network-ipv4addr"
	help
	  Calculates IPv4 elements from an address.

	  https://metacpan.org/release/Network-IPv4Addr
```

## aroio/package/perl-readonly/Config.in
```kconfig
config BR2_PACKAGE_PERL_READONLY
	bool "perl-readonly"
	help
	  Facility for creating read-only scalars, arrays, hashes

	  https://github.com/sanko/readonly
```

## aroio/package/perl-soap-lite/Config.in
```kconfig
config BR2_PACKAGE_PERL_SOAP_LITE
	bool "perl-soap-lite"
	help
	  SOAP::Lite - Perl's Web Services Toolkit

	  http://search.cpan.org/~phred/SOAP-Lite-1.20/lib/SOAP/Lite.pm
```

## aroio/package/perl-sql-abstract-limit/Config.in
```kconfig
config BR2_PACKAGE_PERL_SQL_ABSTRACT_LIMIT
	bool "perl-sql-abstract-limit"
	depends on !BR2_STATIC_LIBS
	select BR2_PACKAGE_PERL_DBI
	select BR2_PACKAGE_PERL_SQL_ABSTRACT
	help
	  Helper package for testing generated SQL and bind values

	  https://metacpan.org/release/SQL-Abstract-Limit

comment "perl-sql-abstract-limit needs a toolchain w/ dynamic library"
	depends on BR2_STATIC_LIBS
```

## aroio/package/perl-sql-abstract/Config.in
```kconfig
config BR2_PACKAGE_PERL_SQL_ABSTRACT
	bool "perl-sql-abstract"
	select BR2_PACKAGE_PERL_HASH_MERGE
	select BR2_PACKAGE_PERL_MRO_COMPAT
	select BR2_PACKAGE_PERL_MOO
	select BR2_PACKAGE_PERL_SUB_QUOTE
	help
	  Generate SQL from Perl data structures

	  https://metacpan.org/release/SQL-Abstract
```

## aroio/package/perl-sub-uplevel/Config.in
```kconfig
config BR2_PACKAGE_PERL_SUB_UPLEVEL
	bool "perl-sub-uplevel"
	help
	  apparently run a function in a higher stack frame

	  https://github.com/Perl-Toolchain-Gang/Sub-Uplevel
```

## aroio/package/perl-template-toolkit/Config.in
```kconfig
config BR2_PACKAGE_PERL_TEMPLATE_TOOLKIT
	bool "perl-template-toolkit"
	depends on !BR2_STATIC_LIBS
	select BR2_PACKAGE_PERL_APPCONFIG
	help
	  comprehensive template processing system

	  https://metacpan.org/release/Template-Toolkit

comment "perl-template-toolkit needs a toolchain w/ dynamic library"
	depends on BR2_STATIC_LIBS
```

## aroio/package/perl-text-unidecode/Config.in
```kconfig
config BR2_PACKAGE_PERL_TEXT_UNIDECODE
	bool "perl-text-unidecode"
	help
	  Provide plain ASCII transliterations of Unicode text

	  https://metacpan.org/release/Text-Unidecode
```

## aroio/package/perl-tie-cache-lru-expires/Config.in
```kconfig
config BR2_PACKAGE_PERL_TIE_CACHE_LRU_EXPIRES
	bool "perl-tie-cache-lru-expires"
	select BR2_PACKAGE_PERL_TIE_CACHE_LRU
	help
	  Extends Tie::Cache::LRU with expiring

	  https://metacpan.org/release/Tie-Cache-LRU-Expires
```

## aroio/package/perl-tie-cache-lru/Config.in
```kconfig
config BR2_PACKAGE_PERL_TIE_CACHE_LRU
	bool "perl-tie-cache-lru"
	select BR2_PACKAGE_PERL_CARP_ASSERT
	select BR2_PACKAGE_PERL_CLASS_DATA_INHERITABLE
	select BR2_PACKAGE_PERL_CLASS_VIRTUAL
	select BR2_PACKAGE_PERL_ENUM
	help
	  A Least-Recently Used cache

	  https://metacpan.org/release/Tie-Cache-LRU
```

## aroio/package/perl-tie-regexphash/Config.in
```kconfig
config BR2_PACKAGE_PERL_TIE_REGEXPHASH
	bool "perl-tie-regexphash"
	help
	  Use regular expressions as hash keys

	  https://metacpan.org/release/Tie-RegexpHash
```

## aroio/package/perl-tree-dag-node/Config.in
```kconfig
config BR2_PACKAGE_PERL_TREE_DAG_NODE
	bool "perl-tree-dag-node"
	select BR2_PACKAGE_PERL_FILE_SLURP_TINY
	help
	  An N-ary tree

	  https://metacpan.org/release/Tree-DAG_Node
```

## aroio/package/perl-types-serialiser/Config.in
```kconfig
config BR2_PACKAGE_PERL_TYPES_SERIALISER
	bool "perl-types-serialiser"
	select BR2_PACKAGE_PERL_COMMON_SENSE
	help
	  simple data types for common serialisation formats

	  https://metacpan.org/release/Types-Serialiser
```

## aroio/package/perl-uri-find/Config.in
```kconfig
config BR2_PACKAGE_PERL_URI_FIND
	bool "perl-uri-find"
	select BR2_PACKAGE_PERL_URI
	help
	  Find URIs in arbitrary text

	  http://metacpan.org/release/URI-Find
```

## aroio/package/perl-uuid-tiny/Config.in
```kconfig
config BR2_PACKAGE_PERL_UUID_TINY
	bool "perl-uuid-tiny"
	help
	  Pure Perl UUID Support With Functional Interface

	  https://metacpan.org/release/UUID-Tiny
```

## aroio/package/perl-xml-parser/Config.in
```kconfig
config BR2_PACKAGE_PERL_XML_PARSER
	bool "perl-xml-parser"
	depends on !BR2_STATIC_LIBS
	select BR2_PACKAGE_PERL_LIBWWW_PERL
	help
	  A perl module for parsing XML documents

	  https://metacpan.org/release/XML-Parser

comment "perl-xml-parser needs a toolchain w/ dynamic library"
	depends on BR2_STATIC_LIBS
```

## aroio/package/perl-xml-sax-expat/Config.in
```kconfig
config BR2_PACKAGE_PERL_XML_SAX_EXPAT
	bool "perl-xml-sax-expat"
	depends on !BR2_STATIC_LIBS
	select BR2_PACKAGE_PERL_XML_NAMESPACESUPPORT
	select BR2_PACKAGE_PERL_XML_PARSER
	select BR2_PACKAGE_PERL_XML_SAX
	select BR2_PACKAGE_PERL_XML_SAX_BASE
	help
	  SAX Driver for Expat

	  https://metacpan.org/release/XML-SAX-Expat

comment "perl-xml-sax-expat needs a toolchain w/ dynamic library"
	depends on BR2_STATIC_LIBS
```

## aroio/package/perl-xml-simple/Config.in
```kconfig
config BR2_PACKAGE_PERL_XML_SIMPLE
	bool "perl-xml-simple"
	depends on !BR2_STATIC_LIBS
	select BR2_PACKAGE_PERL_XML_NAMESPACESUPPORT
	select BR2_PACKAGE_PERL_XML_SAX
	select BR2_PACKAGE_PERL_XML_SAX_EXPAT
	help
	  An API for simple XML files

	  https://metacpan.org/release/XML-Simple

comment "perl-xml-simple needs a toolchain w/ dynamic library"
	depends on BR2_STATIC_LIBS
```

## aroio/package/perl-yaml-libyaml/Config.in
```kconfig
config BR2_PACKAGE_PERL_YAML_LIBYAML
	bool "perl-yaml-libyaml"
	depends on !BR2_STATIC_LIBS
	help
	  Perl YAML Serialization using XS and libyaml

	  https://github.com/ingydotnet/yaml-libyaml-pm

comment "perl-yaml-libyaml needs a toolchain w/ dynamic library"
	depends on BR2_STATIC_LIBS
```

## aroio/package/python-fastapi/Config.in
```kconfig
config BR2_PACKAGE_PYTHON_FASTAPI
	bool "python-fastapi"
	select BR2_PACKAGE_PYTHON_PYDANTIC # runtime
	select BR2_PACKAGE_PYTHON_STARLETTE # runtime
	help
	  FastAPI framework, high performance, easy to learn, fast to
	  code, ready for production.

	  https://github.com/tiangolo/fastapi
```

## aroio/package/python-httptools/Config.in
```kconfig
config BR2_PACKAGE_PYTHON_HTTPTOOLS
	bool "python-httptools"
	help
	  A collection of framework independent HTTP protocol utils.

	  https://github.com/MagicStack/httptools
```

## aroio/package/python-prctl/Config.in
```kconfig
config BR2_PACKAGE_PYTHON_PRCTL
	bool "python-prctl"
	help
	  python-prctl -- Control process attributes through prctl

	  https://github.com/seveas/python-prctl
```
