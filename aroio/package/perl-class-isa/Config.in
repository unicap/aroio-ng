## aroio/package/perl-class-isa/Config.in
```kconfig
config BR2_PACKAGE_PERL_CLASS_ISA
	bool "perl-class-isa"
	help
	  report the search path for a class's ISA tree

	  https://metacpan.org/release/Class-ISA
```

## aroio/package/perl-class-virtual/Config.in
```kconfig
config BR2_PACKAGE_PERL_CLASS_VIRTUAL
	bool "perl-class-virtual"
	select BR2_PACKAGE_PERL_CARP_ASSERT
	select BR2_PACKAGE_PERL_CLASS_DATA_INHERITABLE
	select BR2_PACKAGE_PERL_CLASS_ISA
	help
	  Base class for virtual base classes.

	  https://metacpan.org/release/Class-Virtual
```

## aroio/package/perl-clone-choose/Config.in
```kconfig
config BR2_PACKAGE_PERL_CLONE_CHOOSE
	bool "perl-clone-choose"
	help
	  Choose appropriate clone utility

	  https://metacpan.org/release/Clone-Choose
```

## aroio/package/perl-common-sense/Config.in
```kconfig
config BR2_PACKAGE_PERL_COMMON_SENSE
	bool "perl-common-sense"
	help
	  save a tree AND a kitten, use common::sense!

	  https://metacpan.org/release/common-sense
```

## aroio/package/perl-compress-raw-zlib/Config.in
```kconfig
config BR2_PACKAGE_PERL_COMPRESS_RAW_ZLIB
	bool "perl-compress-raw-zlib"
	depends on !BR2_STATIC_LIBS
	help
	  Basic utilities for writing tests.

	  https://metacpan.org/release/Compress-Raw-Zlib

comment "perl-compress-raw-zlib needs a toolchain w/ dynamic library"
	depends on BR2_STATIC_LIBS
```

## aroio/package/perl-context-preserve/Config.in
```kconfig
config BR2_PACKAGE_PERL_CONTEXT_PRESERVE
	bool "perl-context-preserve"
	help
	  Run code after a subroutine call, preserving the context the subroutine would have seen if it were the last statement in the caller

	  https://github.com/karenetheridge/Context-Preserve
```

## aroio/package/perl-data-dumper-concise/Config.in
```kconfig
config BR2_PACKAGE_PERL_DATA_DUMPER_CONCISE
	bool "perl-data-dumper-concise"
	help
	  Less indentation and newlines plus sub deparsing

	  https://metacpan.org/release/Data-Dumper-Concise
```

## aroio/package/perl-data-uriencode/Config.in
```kconfig
config BR2_PACKAGE_PERL_DATA_URIENCODE
	bool "perl-data-uriencode"
	help
	  Test the uri_encode funcionality

	  https://metacpan.org/release/Data-URIEncode
```

## aroio/package/perl-dbd-mysql/Config.in
```kconfig
config BR2_PACKAGE_PERL_DBD_MYSQL
	bool "perl-dbd-mysql"
	depends on !BR2_STATIC_LIBS
	select BR2_PACKAGE_MYSQL
	select BR2_PACKAGE_OPENSSL
	select BR2_PACKAGE_PERL_DBI
	help
	  A MySQL driver for the Perl5 Database Interface (DBI)

	  http://dbi.perl.org/

comment "perl-dbd-mysql needs a toolchain w/ dynamic library"
	depends on BR2_STATIC_LIBS
```

## aroio/package/perl-enum/Config.in
```kconfig
config BR2_PACKAGE_PERL_ENUM
	bool "perl-enum"
	help
	  C style enumerated types and bitmask flags in Perl

	  https://metacpan.org/release/enum
```

## aroio/package/perl-ev/Config.in
```kconfig
config BR2_PACKAGE_PERL_EV
	bool "perl-ev"
	depends on !BR2_STATIC_LIBS
	select BR2_PACKAGE_PERL_COMMON_SENSE
	help
	  perl interface to libev, a high performance full-featured event loop

	  https://metacpan.org/release/EV

comment "perl-ev needs a toolchain w/ dynamic library"
	depends on BR2_STATIC_LIBS
```

## aroio/package/perl-exporter-lite/Config.in
```kconfig
config BR2_PACKAGE_PERL_EXPORTER_LITE
	bool "perl-exporter-lite"
	help
	  lightweight exporting of functions and variables

	  https://metacpan.org/release/Exporter-Lite
```

## aroio/package/perl-extutils-cbuilder/Config.in
```kconfig
config BR2_PACKAGE_PERL_EXTUTILS_CBUILDER
	bool "perl-extutils-cbuilder"
	help
	  Compile and link C code for Perl modules

	  http://search.cpan.org/dist/ExtUtils-CBuilder
```

## aroio/package/perl-file-bom/Config.in
```kconfig
config BR2_PACKAGE_PERL_FILE_BOM
	bool "perl-file-bom"
	select BR2_PACKAGE_PERL_READONLY
	help
	  Utilities for handling Byte Order Marks

	  https://metacpan.org/release/File-BOM
```

## aroio/package/perl-file-next/Config.in
```kconfig
config BR2_PACKAGE_PERL_FILE_NEXT
	bool "perl-file-next"
	depends on !BR2_STATIC_LIBS
	help
	  File-finding iterator

	  https://metacpan.org/release/File-Next

comment "perl-file-next needs a toolchain w/ dynamic library"
	depends on BR2_STATIC_LIBS
```

## aroio/package/perl-file-slurp-tiny/Config.in
```kconfig
config BR2_PACKAGE_PERL_FILE_SLURP_TINY
	bool "perl-file-slurp-tiny"
	help
	  A simple, sane and efficient file slurper [DISCOURAGED]

	  https://metacpan.org/release/File-Slurp-Tiny
```

## aroio/package/perl-file-which/Config.in
```kconfig
config BR2_PACKAGE_PERL_FILE_WHICH
	bool "perl-file-which"
	help
	  Perl implementation of the which utility as an API

	  https://metacpan.org/pod/File::Which
```

## aroio/package/perl-font-freetype/Config.in
```kconfig
config BR2_PACKAGE_PERL_FONT_FREETYPE
	bool "perl-font-freetype"
	depends on !BR2_STATIC_LIBS
	help
	  read font files and render glyphs from Perl using FreeType2

	  https://metacpan.org/release/Font-FreeType

comment "perl-font-freetype needs a toolchain w/ dynamic library"
	depends on BR2_STATIC_LIBS
```

## aroio/package/perl-hash-merge/Config.in
```kconfig
config BR2_PACKAGE_PERL_HASH_MERGE
	bool "perl-hash-merge"
	select BR2_PACKAGE_PERL_CLONE_CHOOSE
	help
	  Merges arbitrarily deep hashes into a single hash

	  https://metacpan.org/release/Hash-Merge
```

## aroio/package/perl-image-scale/Config.in
```kconfig
config BR2_PACKAGE_PERL_IMAGE_SCALE
	bool "perl-image-scale"
	depends on !BR2_STATIC_LIBS
	help
	  Fast, high-quality fixed-point image resizing

	  https://metacpan.org/release/Image-Scale

comment "perl-image-scale needs a toolchain w/ dynamic library"
	depends on BR2_STATIC_LIBS
```

## aroio/package/perl-io-aio/Config.in
```kconfig
config BR2_PACKAGE_PERL_IO_AIO
	bool "perl-io-aio"
	depends on !BR2_STATIC_LIBS
	select BR2_PACKAGE_PERL_COMMON_SENSE
	help
	  Asynchronous Input/Output

	  https://metacpan.org/release/IO-AIO

comment "perl-io-aio needs a toolchain w/ dynamic library"
	depends on BR2_STATIC_LIBS
```

## aroio/package/perl-io-string/Config.in
```kconfig
config BR2_PACKAGE_PERL_IO_STRING
	bool "perl-io-string"
	help
	  Emulate file interface for in-core strings

	  https://metacpan.org/release/IO-String
```

## aroio/package/perl-json-xs-versiononeandtwo/Config.in
```kconfig
config BR2_PACKAGE_PERL_JSON_XS_VERSIONONEANDTWO
	bool "perl-json-xs-versiononeandtwo"
	depends on !BR2_STATIC_LIBS
	select BR2_PACKAGE_PERL_JSON_XS
	help
	  Support versions 1 and 2 of JSON::XS

	  https://metacpan.org/release/JSON-XS-VersionOneAndTwo

comment "perl-json-xs-versiononeandtwo needs a toolchain w/ dynamic library"
	depends on BR2_STATIC_LIBS
```

## aroio/package/perl-json-xs/Config.in
```kconfig
config BR2_PACKAGE_PERL_JSON_XS
	bool "perl-json-xs"
	depends on !BR2_STATIC_LIBS
	select BR2_PACKAGE_PERL_TYPES_SERIALISER
	select BR2_PACKAGE_PERL_COMMON_SENSE
	help
	  JSON serialising/deserialising, done correctly and fast

	  https://metacpan.org/release/JSON-XS

comment "perl-json-xs needs a toolchain w/ dynamic library"
	depends on BR2_STATIC_LIBS
```

## aroio/package/perl-linux-inotify2/Config.in
```kconfig
config BR2_PACKAGE_PERL_LINUX_INOTIFY2
	bool "perl-linux-inotify2"
	depends on !BR2_STATIC_LIBS
	select BR2_PACKAGE_PERL_COMMON_SENSE
	help
	  scalable directory/file change notification

	  https://metacpan.org/release/Linux-Inotify2

comment "perl-linux-inotify2 needs a toolchain w/ dynamic library"
	depends on BR2_STATIC_LIBS
```
