## aroio/package/python-pybluez/Config.in
```kconfig
config BR2_PACKAGE_PYTHON_PYBLUEZ
	bool "python-pybluez"
	#select BR2_PACKAGE_PYTHON_SIX # runtime
	#select BR2_PACKAGE_PYTHON_SERIAL # runtime
	help
	  Pybluez allows Python code to access the hosts BT-resources.

	  https://github.com/pybluez/pybluez
```

## aroio/package/python-starlette/Config.in
```kconfig
config BR2_PACKAGE_PYTHON_STARLETTE
	bool "python-starlette"
	help
	  The little ASGI library that shines.

	  https://github.com/encode/starlette
```

## aroio/package/python-uvicorn/Config.in
```kconfig
config BR2_PACKAGE_PYTHON_UVICORN
	bool "python-uvicorn"
	select BR2_PACKAGE_PYTHON_CLICK # runtime
	select BR2_PACKAGE_PYTHON_H11 # runtime
	select BR2_PACKAGE_PYTHON_HTTPTOOLS # runtime
	select BR2_PACKAGE_PYTHON_UVLOOP # runtime
	select BR2_PACKAGE_PYTHON_WEBSOCKETS # runtime
	help
	  The lightning-fast ASGI server.

	  https://github.com/encode/uvicorn
```

## aroio/package/rtl8812au/Config.in
```kconfig
config BR2_PACKAGE_RTL8812AU
	   bool "RTL8812AU driver"
	   depends on BR2_LINUX_KERNEL
	   help
	    Realtek RTL8812AU linux driver 
```

## aroio/package/slimserver/Config.in
```kconfig
config BR2_PACKAGE_SLIMSERVER
	bool "slimserver"
	depends on BR2_USE_MMU
	depends on BR2_TOOLCHAIN_HAS_THREADS_NPTL
	select BR2_PACKAGE_LIBMEDIASCAN
	select BR2_PACKAGE_PERL
	select BR2_PACKAGE_EXPAT
	select BR2_PACKAGE_PERL_ANYEVENT
	select BR2_PACKAGE_PERL_ARCHIVE_ZIP
	select BR2_PACKAGE_PERL_AUDIO_CUEFILE_PARSER
	select BR2_PACKAGE_PERL_AUDIO_SCAN
	select BR2_PACKAGE_PERL_CARP_CLAN
	select BR2_PACKAGE_PERL_CGI
	select BR2_PACKAGE_PERL_CLASS_ACCESSOR_CHAINED
	select BR2_PACKAGE_PERL_CLASS_ACCESSOR_FAST
	select BR2_PACKAGE_PERL_CLASS_DATA_INHERITABLE
	select BR2_PACKAGE_PERL_CLASS_C3_XS
	select BR2_PACKAGE_PERL_CLASS_INSPECTOR
	select BR2_PACKAGE_PERL_CLASS_XSACCESSOR
	select BR2_PACKAGE_PERL_COMMON_SENSE
	select BR2_PACKAGE_PERL_COMPRESS_RAW_ZLIB
	select BR2_PACKAGE_PERL_CONTEXT_PRESERVE
	select BR2_PACKAGE_PERL_DATA_DUMP
	select BR2_PACKAGE_PERL_DATA_PAGE
	select BR2_PACKAGE_PERL_DATA_URIENCODE
	select BR2_PACKAGE_PERL_DBD_MYSQL
	select BR2_PACKAGE_PERL_DBD_SQLITE
	select BR2_PACKAGE_PERL_DBIX_CLASS
	select BR2_PACKAGE_PERL_DIGEST_SHA1
	select BR2_PACKAGE_PERL_ENCODE_DETECT
	select BR2_PACKAGE_PERL_EV
	select BR2_PACKAGE_PERL_EXTUTILS_CBUILDER
	select BR2_PACKAGE_PERL_EXPORTER_LITE
	select BR2_PACKAGE_PERL_FILE_BOM
	select BR2_PACKAGE_PERL_FILE_NEXT
	select BR2_PACKAGE_PERL_FILE_READBACKWARDS
	select BR2_PACKAGE_PERL_FILE_SLURP
	select BR2_PACKAGE_PERL_FILE_WHICH
	select BR2_PACKAGE_PERL_FONT_FREETYPE
	select BR2_PACKAGE_PERL_HTML_PARSER
	select BR2_PACKAGE_PERL_HTML_TAGSET
	select BR2_PACKAGE_PERL_HTTP_DAEMON
	select BR2_PACKAGE_PERL_HTTP_MESSAGE
	select BR2_PACKAGE_PERL_HTTP_COOKIES
	select BR2_PACKAGE_PERL_IMAGE_SCALE
	select BR2_PACKAGE_PERL_IO_AIO
	select BR2_PACKAGE_PERL_IO_INTERFACE
	select BR2_PACKAGE_PERL_IO_SOCKET_SSL
	select BR2_PACKAGE_PERL_IO_STRING
	select BR2_PACKAGE_PERL_JSON_XS
	select BR2_PACKAGE_PERL_JSON_XS_VERSIONONEANDTWO
	select BR2_PACKAGE_PERL_LIBWWW_PERL
	select BR2_PACKAGE_PERL_LINUX_INOTIFY2
	select BR2_PACKAGE_PERL_LOG_LOG4PERL
	select BR2_PACKAGE_PERL_LWP_MEDIATYPES
	select BR2_PACKAGE_PERL_MP3_CUT_GAPLESS
	select BR2_PACKAGE_PERL_NET_HTTP
	select BR2_PACKAGE_PERL_NETWORK_IPV4ADDR
	select BR2_PACKAGE_PERL_PACKAGE_STASH
	select BR2_PACKAGE_PERL_PATH_CLASS
	select BR2_PACKAGE_PERL_PROC_BACKGROUND
	select BR2_PACKAGE_PERL_SOAP_LITE
	select BR2_PACKAGE_PERL_SQL_ABSTRACT
	select BR2_PACKAGE_PERL_SQL_ABSTRACT_LIMIT
	select BR2_PACKAGE_PERL_SUB_NAME
	select BR2_PACKAGE_PERL_SUB_UPLEVEL
	select BR2_PACKAGE_PERL_TEMPLATE_TOOLKIT
	select BR2_PACKAGE_PERL_TEXT_UNIDECODE
	select BR2_PACKAGE_PERL_TIE_CACHE_LRU
	select BR2_PACKAGE_PERL_TIE_CACHE_LRU_EXPIRES
	select BR2_PACKAGE_PERL_TIE_REGEXPHASH
	select BR2_PACKAGE_PERL_TIMEDATE
	select BR2_PACKAGE_PERL_TREE_DAG_NODE
	select BR2_PACKAGE_PERL_URI
	select BR2_PACKAGE_PERL_URI_FIND
	select BR2_PACKAGE_PERL_UUID_TINY
	select BR2_PACKAGE_PERL_XML_PARSER
	select BR2_PACKAGE_PERL_XML_SIMPLE
	select BR2_PACKAGE_PERL_YAML_LIBYAML
	help
	  Logitech slimserver
```

## aroio/package/spotifyd/Config.in
```kconfig
config BR2_PACKAGE_SPOTIFYD
	bool "spotifyd"
	depends on BR2_PACKAGE_HOST_RUSTC_TARGET_ARCH_SUPPORTS
	select BR2_PACKAGE_HOST_CARGO
	help
		Open source spotify client running as a daemon

		https://github.com/Spotifyd/spotifyd
```

## aroio/package/squeezelite-jack/Config.in
```kconfig
config BR2_PACKAGE_SQUEEZELITE_JACK
	bool "squeezelite-jack"
	depends on BR2_USE_WCHAR # flac
	depends on BR2_TOOLCHAIN_HAS_THREADS # alsa-lib
	depends on BR2_USE_MMU # mpg123
	select BR2_PACKAGE_ALSA_LIB
	select BR2_PACKAGE_ALSA_LIB_MIXER
	select BR2_PACKAGE_FLAC
	select BR2_PACKAGE_LIBMAD
	select BR2_PACKAGE_LIBVORBIS
	select BR2_PACKAGE_FAAD2
	select BR2_PACKAGE_MPG123
	select BR2_PACKAGE_JACK2
	help
	  Logitech Media Server client

	  https://code.google.com/p/squeezelite/

if BR2_PACKAGE_SQUEEZELITE_JACK

config BR2_PACKAGE_SQUEEZELITE_JACK_FFMPEG
	bool "Enable WMA and ALAC decoding"
	default y
	select BR2_PACKAGE_FFMPEG
	depends on !BR2_TOOLCHAIN_EXTERNAL_CODESOURCERY_NIOSII201305 # ffmpeg
	depends on !BR2_TOOLCHAIN_EXTERNAL_CODESOURCERY_NIOSII201405 # ffmpeg

config BR2_PACKAGE_SQUEEZELITE_JACK_DSD
	bool "Enable DSD decoding"

config BR2_PACKAGE_SQUEEZELITE_JACK_RESAMPLE
	bool "Enable resampling support"
	select BR2_PACKAGE_LIBSOXR

config BR2_PACKAGE_SQUEEZELITE_JACK_VISEXPORT
	bool "Enable visualiser support"

endif

comment "squeezelite-jack needs a toolchain w/ wchar, threads"
	depends on BR2_USE_MMU
	depends on !BR2_USE_WCHAR || !BR2_TOOLCHAIN_HAS_THREADS
```

## aroio/package/webinterface/Config.in
```kconfig
config BR2_PACKAGE_WEBINTERFACE
    bool "webinterface"
    help
        Aroio Webinterace - Python based API and Angular based Interface
```

## buildroot/package/gobject-introspection/Config.in
```kconfig
config BR2_PACKAGE_GOBJECT_INTROSPECTION
	bool "gobject-introspection"
	depends on BR2_PACKAGE_HOST_QEMU_ARCH_SUPPORTS
	depends on BR2_TOOLCHAIN_HAS_THREADS # libffi, libglib2
	depends on BR2_TOOLCHAIN_USES_GLIBC
	depends on BR2_USE_MMU # python3, libglib2
	depends on BR2_USE_WCHAR # python3, libglib2 -> gettext
	depends on !BR2_STATIC_LIBS
	depends on !BR2_MIPS_NABI32
	select BR2_PACKAGE_LIBFFI
	select BR2_PACKAGE_ZLIB
	select BR2_PACKAGE_LIBGLIB2
	select BR2_PACKAGE_HOST_QEMU
	select BR2_PACKAGE_HOST_QEMU_LINUX_USER_MODE
	select BR2_PACKAGE_PYTHON3 if !BR2_PACKAGE_PYTHON
	help
	  GObject introspection is a middleware layer between C
	  libraries (using GObject) and language bindings. The C library
	  can be scanned at compile time and generate a metadata file,
	  in addition to the actual native C library. Then at runtime,
	  language bindings can read this metadata and automatically
	  provide bindings to call into the C library.

	  https://wiki.gnome.org/action/show/Projects/GObjectIntrospection

comment "gobject-introspection needs a glibc toolchain w/ wchar, threads, dynamic library"
	depends on BR2_USE_MMU
	depends on BR2_PACKAGE_GOBJECT_INTROSPECTION_ARCH_SUPPORTS_TARGET
	depends on !BR2_USE_WCHAR || !BR2_TOOLCHAIN_HAS_THREADS || \
		BR2_STATIC_LIBS || !BR2_TOOLCHAIN_USES_GLIBC
```

## buildroot/package/kmod/Config.in
```kconfig
config BR2_PACKAGE_KMOD
	bool "kmod"
	depends on !BR2_STATIC_LIBS
	help
	  handle kernel modules

	  http://git.kernel.org/?p=utils/kernel/kmod/kmod.git

if BR2_PACKAGE_KMOD

config BR2_PACKAGE_KMOD_TOOLS
	bool "kmod utilities"
	depends on BR2_PACKAGE_BUSYBOX_SHOW_OTHERS
	help
	  Install kmod module utilities (depmod, insmod, lsmod,
	  modinfo, modprobe, rmmod).

config BR2_PACKAGE_KMOD_PYTHON
	bool "Python bindings for kmod"
	depends on !BR2_PACKAGE_BLUEZ5_UTILS
	help
	  Build Python bindings for kmod

comment "kmod Python bindings conflict with bluez5_utils because of a circular dependency"
    depends on BR2_PACKAGE_BLUEZ5_UTILS

endif

comment "kmod needs a toolchain w/ dynamic library"
	depends on BR2_STATIC_LIBS
```

## buildroot/package/prelink-cross/Config.in.host
```kconfig
config BR2_PACKAGE_HOST_PRELINK_CROSS
	bool "host prelink-cross"
	help
	  Emulate a runtime linker for a given sysroot.

	  https://wiki.yoctoproject.org/wiki/Cross-Prelink
```
